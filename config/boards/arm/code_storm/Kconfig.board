## config/boards/arm/code_storm/Kconfig.board
```kconfig
# Jorian840 board configuration

# Copyright (c) 2022 The ZMK Contributors
# SPDX-License-Identifier: MIT

config BOARD_CODE_STORM
	bool "code_storm"
	depends on SOC_NRF52840_QIAA
```
